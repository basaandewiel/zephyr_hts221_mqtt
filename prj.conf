## Kconfig
```
# Copyright (c) 2019 Nordic Semiconductor ASA
# SPDX-License-Identifier: Apache-2.0

#config USB_DEVICE_PID
#	default USB_PID_CONSOLE_SAMPLE

#baswi enable sensors
CONFIGBOARD_ARDUINO_NANO_33_BLE_INIT_SENSORS=y 

source "Kconfig.zephyr"
```

## prj.conf
```kconfig
CONFIG_BOARD_ARDUINO_NANO_33_BLE_INIT_SENSORS=y
#CONFIG_BOOTLOADER_MCUBOOT=y #this makes /dev/ttyACM0 vanish (after some seconds)

CONFIG_SPI=n

CONFIG_I2C=y
CONFIG_SENSOR=y
CONFIG_HTS221=y
CONFIG_HTS221_TRIGGER_NONE=y
#
CONFIG_USB_DEVICE_STACK=y
CONFIG_USB_DEVICE_PRODUCT="Zephyr USB console sample"

CONFIG_SERIAL=y
CONFIG_CONSOLE=y
CONFIG_UART_CONSOLE=y
CONFIG_UART_LINE_CTRL=y


CONFIG_STDOUT_CONSOLE=y
CONFIG_CBPRINTF_FP_SUPPORT=y
```

## app.overlay
```dts
/*
 * Copyright (c) 2021 Nordic Semiconductor ASA
 *
 * SPDX-License-Identifier: Apache-2.0
 */

/ {
	chosen {
		zephyr,console = &cdc_acm_uart0;
	};
};

&zephyr_udc0 {
	cdc_acm_uart0: cdc_acm_uart0 {
		compatible = "zephyr,cdc-acm-uart";
		label = "CDC_ACM_0";
	};
};
```

## src/main.c
```c
/*
 * Copyright (c) 2017 Linaro Limited
 *
 * SPDX-License-Identifier: Apache-2.0
 */

#include <zephyr.h>
#include <device.h>
#include <drivers/sensor.h>
#include <stdio.h>
#include <sys/util.h>

#include <sys/printk.h>
#include <usb/usb_device.h>
#include <drivers/uart.h>

const struct device *dev;

static void process_sample(const struct device *dev)
{
	struct sensor_value temp, hum;
	if (sensor_sample_fetch(dev) < 0) {
		printk("Sensor sample update error\n");
		return;
	}

	if (sensor_channel_get(dev, SENSOR_CHAN_AMBIENT_TEMP, &temp) < 0) {
		printk("Cannot read HTS221 temperature channel\n");
		return;
	}

	if (sensor_channel_get(dev, SENSOR_CHAN_HUMIDITY, &hum) < 0) {
		printk("Cannot read HTS221 humidity channel\n");
		return;
	}

	/* display temperature */
	printk("Temperature:%.1f C\n", sensor_value_to_double(&temp));

	/* display humidity */
	printk("Relative Humidity:%.1f%%\n",
	       sensor_value_to_double(&hum));
}

void init_usb_serial(void) {
	uint32_t dtr = 0;

	if (usb_enable(NULL)) {
		return;
	}

	/* Poll if the DTR flag was set */
	dev = DEVICE_DT_GET(DT_CHOSEN(zephyr_console));
	while (!dtr) {
		uart_line_ctrl_get(dev, UART_LINE_CTRL_DTR, &dtr);
		/* Give CPU resources to low priority threads. */
		k_sleep(K_MSEC(100));
	}
	k_sleep(K_MSEC(5000)); //give user time to start 'screen /dev/ttyACM0'
}

void main(void)
{
	init_usb_serial();	//so we can printk to console

    dev = device_get_binding("HTS221");  //string must match string in device tree
 	//dev = device_get_binding(DT_LABEL(DT_INST(0, st_hts221)));

	if (dev == NULL) {
		printk("Could not get HTS221 device\n");
		return;
	}

	while (true) {
		process_sample(dev);
		k_sleep(K_MSEC(2000));
	}
}
```
